#include <Wire.h>
#include <Adafruit_GFX.h>
#include <Adafruit_SSD1306.h>
// #include <DHTesp.h>
// #include <WiFi.h>

#define SCREEN_WIDTH 128
#define SCREEN_HEIGHT 64
#define OLED_RESET -1
#define SCREEN_ADDRESS 0x3C

const char* NTP_SERVER = "pool.ntp.org"; 
float  UTC_OFFSET = 0;    
float   UTC_OFFSET_DST = 0;

#define BUZZER 5
#define LED_1 5
#define PB_CANCEL 34
#define PB_OK 2
#define PB_UP 3
#define PB_DOWN 4
// #define DHTPIN 12

unsigned long vibrationStartTime = 0;  // To track when the vibration started
const unsigned long vibrationDuration = 5000;  // Vibration duration in milliseconds
bool isVibrating = false;


// Declare Objects
Adafruit_SSD1306 display(SCREEN_WIDTH, SCREEN_HEIGHT, &Wire, OLED_RESET);
// DHTesp dhtSensor;

// global variables
int days = 0;
int hours = 0;
int minutes = 0;
int seconds = 0;

bool Menu=false;

unsigned long timeNow = 0;
unsigned long timeLast = 0;

bool alarm_enabled = true;
int n_alarms = 3;
int alarm_hours[] = {0, 1, 2};
int alarm_minutes[] = {1, 10,20};
bool alarm_triggered[] = {false, false};

int n_notes = 8;
int C = 262;
int D = 294;
int E = 330;
int F = 349;
int G = 392;
int A = 440;
int B = 494;
int C_H = 523;
int notes[] = {C, D, E, F, G, A, B, C_H};

int current_mode = 0;
int max_modes = 7;

unsigned long previousMillis = 0;
int no_ok=0;

// 'PulseX7', 128x64px
const unsigned char menue7 [] PROGMEM = {
	0x00, 0x00, 0x00, 0x00, 0x00, 0x00, 0x00, 0x00, 0x00, 0x00, 0x00, 0x00, 0x00, 0x00, 0x00, 0x00, 
	0x00, 0x00, 0x00, 0x00, 0x00, 0x00, 0x00, 0x00, 0x00, 0x00, 0x00, 0x00, 0x00, 0x00, 0x00, 0x08, 
	0x00, 0x00, 0x00, 0x00, 0x00, 0x00, 0x00, 0x00, 0x00, 0x00, 0x00, 0x00, 0x00, 0x00, 0x00, 0x00, 
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	0x00, 0x00, 0x00, 0x00, 0x00, 0x00, 0x00, 0x00, 0x00, 0x00, 0x00, 0x00, 0x00, 0x00, 0x00, 0x08
};
// 'PulseX 6', 128x64px
const unsigned char menue6 [] PROGMEM = {
	0x00, 0x00, 0x00, 0x00, 0x00, 0x00, 0x00, 0x00, 0x00, 0x00, 0x00, 0x00, 0x00, 0x00, 0x00, 0x00, 
	0x00, 0x00, 0x00, 0x00, 0x00, 0x00, 0x00, 0x00, 0x00, 0x00, 0x00, 0x00, 0x00, 0x00, 0x00, 0x08, 
	0x00, 0x00, 0x00, 0x00, 0x00, 0x00, 0x00, 0x00, 0x00, 0x00, 0x00, 0x00, 0x00, 0x00, 0x00, 0x00, 
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	0x00, 0x00, 0x00, 0x00, 0x00, 0x00, 0x00, 0x00, 0x00, 0x00, 0x00, 0x00, 0x00, 0x00, 0x00, 0x08
};
// 'PulseX 5', 128x64px
const unsigned char menue5 [] PROGMEM = {
	0x00, 0x00, 0x00, 0x00, 0x00, 0x00, 0x00, 0x00, 0x00, 0x00, 0x00, 0x00, 0x00, 0x00, 0x00, 0x00, 
	0x00, 0x00, 0x00, 0x00, 0x00, 0x00, 0x00, 0x00, 0x00, 0x00, 0x00, 0x00, 0x00, 0x00, 0x00, 0x08, 
	0x00, 0x00, 0x00, 0x00, 0x00, 0x00, 0x00, 0x00, 0x00, 0x00, 0x00, 0x00, 0x00, 0x00, 0x00, 0x00, 
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	0x00, 0x00, 0x00, 0x00, 0x00, 0x00, 0x00, 0x00, 0x00, 0x00, 0x00, 0x00, 0x00, 0x00, 0x00, 0x08
};
// 'PulseX 4', 128x64px
const unsigned char menue4 [] PROGMEM = {
	0x00, 0x00, 0x00, 0x00, 0x00, 0x00, 0x00, 0x00, 0x00, 0x00, 0x00, 0x00, 0x00, 0x00, 0x00, 0x00, 
	0x00, 0x00, 0x00, 0x00, 0x00, 0x00, 0x00, 0x00, 0x00, 0x00, 0x00, 0x00, 0x00, 0x00, 0x00, 0x08, 
	0x00, 0x00, 0x00, 0x00, 0x00, 0x00, 0x00, 0x00, 0x00, 0x00, 0x00, 0x00, 0x00, 0x00, 0x00, 0x00, 
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	0x00, 0x00, 0x00, 0x00, 0x00, 0x00, 0x00, 0x00, 0x00, 0x00, 0x00, 0x00, 0x00, 0x00, 0x00, 0x08
};
// 'PulseX 3', 128x64px
const unsigned char menue3 [] PROGMEM = {
	0x00, 0x00, 0x00, 0x00, 0x00, 0x00, 0x00, 0x00, 0x00, 0x00, 0x00, 0x00, 0x00, 0x00, 0x00, 0x00, 
	0x00, 0x00, 0x00, 0x00, 0x00, 0x00, 0x00, 0x00, 0x00, 0x00, 0x00, 0x00, 0x00, 0x00, 0x00, 0x08, 
	0x00, 0x00, 0x00, 0x00, 0x00, 0x00, 0x00, 0x00, 0x00, 0x00, 0x00, 0x00, 0x00, 0x00, 0x00, 0x00, 
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	0x00, 0x00, 0x00, 0x00, 0x00, 0x00, 0x00, 0x00, 0x00, 0x00, 0x00, 0x00, 0x00, 0x00, 0x00, 0x08
};
// 'PulseX2', 128x64px
const unsigned char menue2 [] PROGMEM = {
	0x00, 0x00, 0x00, 0x00, 0x00, 0x00, 0x00, 0x00, 0x00, 0x00, 0x00, 0x00, 0x00, 0x00, 0x00, 0x00, 
	0x00, 0x00, 0x00, 0x00, 0x00, 0x00, 0x00, 0x00, 0x00, 0x00, 0x00, 0x00, 0x00, 0x00, 0x00, 0x08, 
	0x00, 0x00, 0x00, 0x00, 0x00, 0x00, 0x00, 0x00, 0x00, 0x00, 0x00, 0x00, 0x00, 0x00, 0x00, 0x00, 
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	0x00, 0x00, 0x00, 0x00, 0x00, 0x00, 0x00, 0x00, 0x00, 0x00, 0x00, 0x00, 0x00, 0x00, 0x00, 0x08
};
// 'PulseX1', 128x64px
const unsigned char menue1 [] PROGMEM = {
	0x00, 0x00, 0x00, 0x00, 0x00, 0x00, 0x00, 0x00, 0x00, 0x00, 0x00, 0x00, 0x00, 0x00, 0x00, 0x00, 
	0x00, 0x00, 0x00, 0x00, 0x00, 0x00, 0x00, 0x00, 0x00, 0x00, 0x00, 0x00, 0x00, 0x00, 0x00, 0x08, 
	0x00, 0x00, 0x00, 0x00, 0x00, 0x00, 0x00, 0x00, 0x00, 0x00, 0x00, 0x00, 0x00, 0x00, 0x00, 0x1c, 
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	0x00, 0x00, 0x00, 0x00, 0x00, 0x00, 0x00, 0x00, 0x00, 0x00, 0x00, 0x00, 0x00, 0x00, 0x00, 0x08
};

// 'Medibox', 128x64px
const unsigned char Medibox [] PROGMEM = {
	0x00, 0x00, 0x00, 0x00, 0x00, 0x00, 0x00, 0x00, 0x00, 0x00, 0x00, 0x00, 0x00, 0x00, 0x00, 0x00, 
	0x7f, 0xff, 0xff, 0xff, 0xff, 0xff, 0xff, 0xff, 0xff, 0xff, 0xff, 0xff, 0xff, 0xff, 0xff, 0xfe, 
	0x40, 0x00, 0x00, 0x00, 0x00, 0x00, 0x00, 0x00, 0x00, 0x00, 0x00, 0x00, 0x00, 0x00, 0x00, 0x02, 
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	0x00, 0x00, 0x00, 0x00, 0x00, 0x00, 0x00, 0x00, 0x00, 0x00, 0x00, 0x00, 0x00, 0x00, 0x00, 0x00
};


// 'GMT Zone', 128x64px
const unsigned char GMT_Zone [] PROGMEM = {
	0x00, 0x00, 0x00, 0x00, 0x00, 0x00, 0x00, 0x00, 0x00, 0x00, 0x00, 0x00, 0x00, 0x00, 0x00, 0x00, 
	0x00, 0x00, 0x00, 0x00, 0x00, 0x00, 0x00, 0x00, 0x00, 0x00, 0x00, 0x00, 0x00, 0x00, 0x00, 0x00, 
	0x00, 0x1f, 0xe0, 0x00, 0x00, 0x00, 0x00, 0x00, 0x00, 0x00, 0x00, 0x00, 0x00, 0x00, 0x00, 0x00, 
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	0x00, 0x00, 0x00, 0x00, 0x00, 0x00, 0x00, 0x00, 0x00, 0x00, 0x00, 0x00, 0x00, 0x00, 0x00, 0x00
};

// 'Alarm1', 128x64px
const unsigned char Alarm1 [] PROGMEM = {
	0x00, 0x00, 0x00, 0x00, 0x00, 0x00, 0x00, 0x00, 0x00, 0x00, 0x00, 0x00, 0x00, 0x00, 0x00, 0x00, 
	0x00, 0x00, 0x00, 0x00, 0x00, 0x00, 0x00, 0x00, 0x00, 0x00, 0x00, 0x00, 0x00, 0x00, 0x00, 0x00, 
	0x00, 0x00, 0x00, 0x00, 0x00, 0x00, 0x00, 0x00, 0x00, 0x00, 0x00, 0x00, 0x00, 0x00, 0x00, 0x00, 
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	0x00, 0x00, 0x00, 0x00, 0x00, 0x00, 0x00, 0x00, 0x00, 0x00, 0x00, 0x00, 0x00, 0x00, 0x00, 0x00
};

// 'Alarm2', 128x64px
const unsigned char Alarm2 [] PROGMEM = {
	0x00, 0x00, 0x00, 0x00, 0x00, 0x00, 0x00, 0x00, 0x00, 0x00, 0x00, 0x00, 0x00, 0x00, 0x00, 0x00, 
	0x00, 0x00, 0x00, 0x00, 0x00, 0x00, 0x00, 0x00, 0x00, 0x00, 0x00, 0x00, 0x00, 0x00, 0x00, 0x00, 
	0x00, 0x00, 0x00, 0x00, 0x00, 0x00, 0x00, 0x00, 0x00, 0x00, 0x00, 0x00, 0x00, 0x00, 0x00, 0x00, 
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	0x00, 0x00, 0x00, 0x00, 0x00, 0x00, 0x00, 0x00, 0x00, 0x00, 0x00, 0x00, 0x00, 0x00, 0x00, 0x00
};

// 'Alarm3', 128x64px
const unsigned char Alarm3 [] PROGMEM = {
	0x00, 0x00, 0x00, 0x00, 0x00, 0x00, 0x00, 0x00, 0x00, 0x00, 0x00, 0x00, 0x00, 0x00, 0x00, 0x00, 
	0x00, 0x00, 0x00, 0x00, 0x00, 0x00, 0x00, 0x00, 0x00, 0x00, 0x00, 0x00, 0x00, 0x00, 0x00, 0x00, 
	0x00, 0x00, 0x00, 0x00, 0x00, 0x00, 0x00, 0x00, 0x00, 0x00, 0x00, 0x00, 0x00, 0x00, 0x00, 0x00, 
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	0x00, 0x00, 0x00, 0x00, 0x00, 0x00, 0x00, 0x00, 0x00, 0x00, 0x00, 0x00, 0x00, 0x00, 0x00, 0x00
};


// 'Disable_Alarm', 128x64px
const unsigned char Disable_Alarm [] PROGMEM = {
	0x00, 0x00, 0x00, 0x00, 0x00, 0x00, 0x00, 0x00, 0x00, 0x00, 0x00, 0x00, 0x00, 0x00, 0x00, 0x00, 
	0x00, 0x00, 0x00, 0x00, 0x00, 0x00, 0x00, 0x00, 0x00, 0x00, 0x00, 0x00, 0x00, 0x00, 0x00, 0x00, 
	0x00, 0x00, 0x00, 0x00, 0x00, 0x00, 0x00, 0x00, 0x00, 0x00, 0x00, 0x00, 0x00, 0x00, 0x00, 0x00, 
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	0x00, 0x00, 0x00, 0x00, 0x00, 0x00, 0x00, 0x00, 0x00, 0x00, 0x00, 0x00, 0x00, 0x00, 0x00, 0x00
};

const unsigned char* modes[] = {
  menue1,
  menue2,
  menue3,
  menue4,
	menue5,
	menue6,
	menue7 };

void setup()
{
    Serial.begin(9600);

    pinMode(BUZZER, OUTPUT);
    pinMode(LED_1, OUTPUT);
    pinMode(PB_CANCEL, INPUT);
    pinMode(PB_OK, INPUT);
    pinMode(PB_UP, INPUT);
    pinMode(PB_DOWN, INPUT);

    // dhtSensor.setup(DHTPIN, DHTesp::DHT22);

    // SSD1306_SWITCHAPVCC = generate display voltage from 3.3V internally
    if (!display.begin(SSD1306_SWITCHCAPVCC, SCREEN_ADDRESS))
    {
        Serial.println(F("SSD1306 allocation failed"));
        for (;;)
            ;
    }

    // show the display buffer on the screen. You MUST call display() after drawing commands to make them visible on the display
    display.display();
    delay(2000);

    // WiFi.begin("Wokwi-GUEST", "", 6);
    // while (WiFi.status() != WL_CONNECTED) {
    //   delay(250);
    //   display.clearDisplay();
    //   print_line("Connecting to WiFi", 0, 0, 2);
    // }

    // display.clearDisplay();
    // print_line("Connected to WiFi", 0, 0, 2);
    // display.clearDisplay();

    // configTime(UTC_OFFSET, UTC_OFFSET_DST, NTP_SERVER);

    // display.clearDisplay();
    // print_line("Welcome to Medibox !", 10, 20, 2);
    // delay(2000);
    // display.clearDisplay();
}

void loop(){
  //Serial.println("Watch is on");
// Check if there's feedback data from the laptop
  if (Serial.available() > 0) {
    String feedback = Serial.readStringUntil('\n');  // Read the feedback from the laptop

    if (feedback == "VIBRATE" && !isVibrating) {
      digitalWrite(LED_1, HIGH);  // Start the vibration motor
      //Serial.println("VIBRATE");
      isVibrating = true;     // Set the vibrating flag
      vibrationStartTime = millis();  // Record the time when vibration starts
    }
  }
  if (isVibrating == true){
    Serial.println("VIBRATE");
  }

  // Check if the vibration time has passed
  if (isVibrating && (millis() - vibrationStartTime >= vibrationDuration)) {
    digitalWrite(LED_1, LOW);  // Stop the vibration motor
    isVibrating = false;   // Reset the vibrating flag
  }
  update_time_with_check_alarm();
  if (digitalRead(PB_OK) == LOW){
    delay(1000);
    Serial.println();
    go_to_menu();
		Menu=false;
		current_mode=0;
  }
  // check_temp();
	update_time();
	
}

void print_line(String text, int column, int row, int text_size)
{
    display.setTextSize(text_size);
    display.setTextColor(SSD1306_WHITE);
    display.setCursor(column, row);
    display.println(text);

    display.display();
}


void update_time_with_check_alarm(void){
  display.clearDisplay();
  // update_time();
  print_time_now();

  if ( alarm_enabled == true ){
    for (int i = 0; i < n_alarms; i++){
      if ( alarm_triggered[i] == false && alarm_hours[i] == hours && alarm_minutes[i] == minutes ){
        ring_alarm();
        alarm_triggered[i] = true;
      }
    }
  }
}

void ring_alarm(){
  display.clearDisplay();
  print_line("MEDICINE TIME!", 0, 0, 2);

  digitalWrite(LED_1, HIGH);

  bool break_happened = false;


  while(break_happened == false && digitalRead(PB_OK) == HIGH){
    for (int i = 0; i < n_notes; i++){
      if(digitalRead(PB_OK) == LOW){
        delay(200);
        break_happened = true;
        break;
      }
      tone(BUZZER, notes[i]);
      delay(500);
      noTone(BUZZER);
      delay(500);
    }
  }
  digitalWrite(LED_1, LOW);
  display.clearDisplay();
}


void update_time()
{
    unsigned long currentMillis = millis();  // Get the current time in milliseconds
    unsigned long elapsedMillis = currentMillis - previousMillis;

    // Check if one second or more has passed
    if (elapsedMillis >= 1000) {
        // Calculate how many seconds have passed
        int elapsedSeconds = elapsedMillis / 1000;
        
        // Update the previousMillis to the current time
        previousMillis = currentMillis;

        // Increment the seconds by the number of elapsed seconds
        seconds += elapsedSeconds;

        // Handle overflow of seconds into minutes
        if (seconds >= 60) {
            minutes += seconds / 60;  // Add full minutes to minutes
            seconds = seconds % 60;   // Keep the remainder in seconds
        }

        // Handle overflow of minutes into hours
        if (minutes >= 60) {
            hours += minutes / 60;    // Add full hours to hours
            minutes = minutes % 60;   // Keep the remainder in minutes
        }

        // Handle overflow of hours into days
        if (hours >= 24) {
            days += hours / 24;       // Add full days to days
            hours = hours % 24;       // Keep the remainder in hours
        }

        // Optionally handle days overflow if needed for months or years
    }
}



void print_time_now(void)
{
    // Manually entered time variables
    char timeString[9];  // Format: HH:MM:SS (8 characters + null terminator)
    
    // Format the time into a string (watch style)
    sprintf(timeString, "%02d:%02d:%02d", hours, minutes, seconds);
    
    // Clear the previous display
    display.clearDisplay();
    
    // Set larger font size for the time display
    display.setTextSize(2.5);               // Text size 3 for a big display
    display.setTextColor(WHITE);          // White color for text (for monochrome displays)

    // Center the time in the display (OLED 128x64)
    int xPosition = (80 - (18 * 3)) / 2; // Center based on display width (128) and text size
    display.setCursor(xPosition, 20);     // Position cursor in the center vertically (adjust as needed)
    
    // Print the large time string to the display
    display.print(timeString);
    
    // Refresh the OLED with new data
    display.display();
}



void go_to_menu(){
  while (Menu==false){
		
    display.clearDisplay();
    display.drawBitmap(0, 0, modes[current_mode], 128, 64, WHITE);
    display.display();

    int pressed = wait_for_button_press();

    if (pressed == PB_UP){
      current_mode += 1;
      current_mode = current_mode % max_modes;
      delay(200);
    }

    else if (pressed == PB_DOWN){
      current_mode -= 1;
      if (current_mode < 0){
        current_mode = max_modes - 1;
      }
      delay(200);
    }

    else if (pressed == PB_OK){
      Serial.println(current_mode);
      delay(200);
      run_mode(current_mode);
    }
  }
}

int wait_for_button_press(){
  while(true){
    if (digitalRead(PB_UP) == LOW){
      delay(200);
      return PB_UP;
    }
    if (digitalRead(PB_DOWN) == LOW){
      delay(200);
      return PB_DOWN;
    }
    if (digitalRead(PB_OK) == LOW){
      delay(200);
      return PB_OK;
    }
    if (digitalRead(PB_CANCEL) == LOW){
      delay(200);
      return PB_CANCEL;
    }
    // update_time();
  }
}

void set_alarm(int alarm){
  int temp_hour = alarm_hours[alarm];
  while(true){
    display.clearDisplay();
    print_line("Enter alarm hour: " + String(temp_hour), 0, 0, 1);

    int pressed = wait_for_button_press();

    if (pressed == PB_UP){
      delay(200);
      temp_hour += 1;
      temp_hour = temp_hour % 24;
    }
    else if (pressed == PB_DOWN){
      delay(200);
      temp_hour -= 1;
      if (temp_hour < 0){
        temp_hour = 23;
      }
    }
    else if (pressed == PB_OK){
      delay(200);
      alarm_hours[alarm] = temp_hour;
      break;
    }
    else if (pressed == PB_CANCEL){
      delay(200);
      break;
    }
  }
  
  int temp_minutes = alarm_minutes[alarm];
  while(true){
    display.clearDisplay();
    print_line("Enter alarm minutes: " + String(temp_minutes), 0, 0, 1);
    
    int pressed = wait_for_button_press();

    if (pressed == PB_UP){
      delay(200);
      temp_minutes += 1;
      temp_minutes = temp_minutes % 60;
    }
    else if (pressed == PB_DOWN){
      delay(200);
      temp_minutes -= 1;
      if (temp_minutes < 0){
        temp_minutes = 59;
      }
    }
    else if (pressed == PB_OK){
      delay(200);
      alarm_minutes[alarm] = temp_minutes;
      break;
    }
    else if (pressed == PB_CANCEL){
      delay(200);
      break;
    }
  }
  
  display.clearDisplay();
  print_line("Alarm is set", 0, 0, 1);
	alarm_enabled = true;
  delay(1000);
}

void run_mode(int mode){
  if (mode == 0){
    Set_time();
  }

  if (mode == 4 || mode == 2||mode==3){
    set_alarm(mode - 1);
  }
  if (mode == 5){
    alarm_enabled = false;
  }
	if (mode == 1){
		while(true){
			display.clearDisplay();
			print_line("BPM=65 ", 0, 0, 1);
			print_line("spo2=99% ", 0, 10, 1);

			int pressed = wait_for_button_press();

			if (pressed == PB_OK){
				delay(200);
				break;
			}
		}	
		
    //Heart_rate();
		//Spo2();
  }
	if (mode == 6){
    Menu=true;
  }
}

void Set_time() {
    int no_ok = 0;  // This will control whether we are adjusting hours, minutes, or seconds

    while (true) {
        display.clearDisplay();
        print_time_now();

				// Underline the selected element
        if (no_ok == 0) {  // Underline hours
            display.drawLine(15, 35, 35, 35, WHITE);  // Adjust X and Y to match your font size
        } else if (no_ok == 1) {  // Underline minutes
            display.drawLine(50, 35, 70, 35, WHITE);  // Adjust X and Y to match your font size
        } else if (no_ok == 2) {  // Underline seconds
            display.drawLine(85, 35, 105, 35, WHITE);  // Adjust X and Y to match your font size
        }

        display.display();  // Refresh display to show the underline
        Serial.println(no_ok);  // Display the current state for debugging

        int pressed = wait_for_button_press();

        // Adjust hours
        if (no_ok == 0 && pressed == PB_UP) {
            delay(200);
            hours = (hours + 1) % 24;  // Wrap-around for 24-hour format
        }
        else if (no_ok == 0 && pressed == PB_DOWN) {
            delay(200);
            hours = (hours - 1 + 24) % 24;  // Handle negative wrap-around for 24-hour format
        }
        else if (no_ok == 0 && pressed == PB_OK) {
            no_ok = 1;  // Move to minutes adjustment
        }

        // Adjust minutes
        else if (no_ok == 1 && pressed == PB_UP) {
            delay(200);
            minutes = (minutes + 1) % 60;  // Wrap-around for minutes
        }
        else if (no_ok == 1 && pressed == PB_DOWN) {
            delay(200);
            minutes = (minutes - 1 + 60) % 60;  // Handle negative wrap-around for minutes
        }
        else if (no_ok == 1 && pressed == PB_OK) {
            no_ok = 2;  // Move to seconds adjustment
        }

        // Adjust seconds
        else if (no_ok == 2 && pressed == PB_UP) {
            delay(200);
            seconds = (seconds + 1) % 60;  // Wrap-around for seconds
        }
        else if (no_ok == 2 && pressed == PB_DOWN) {
            delay(200);
            seconds = (seconds - 1 + 60) % 60;  // Handle negative wrap-around for seconds
        }
        else if (no_ok == 2 && pressed == PB_OK) {
            no_ok = 0;  // Back to hours, or exit
            delay(200);
            break;  // Exit the loop once time is set
        }
    }
}



// void check_temp(){
//   digitalWrite(LED_1, LOW);
//   TempAndHumidity data = dhtSensor.getTempAndHumidity();
//   //Serial.println(data.temperature);
//   if ( data.temperature > 32 ){
//     print_line("Temp HIGH", 2, 40, 1.75);
//     digitalWrite(LED_1, HIGH);
//   }

//   else if ( data.temperature < 26 ){
//     print_line("Temp LOW", 2, 40, 1.75);
//     digitalWrite(LED_1, HIGH);
//   }

//   if ( data.humidity > 80 ){
//     print_line("HUMIDITY HIGH", 2, 50, 1.75);
//     digitalWrite(LED_1, HIGH);
//   }

//   else if ( data.humidity < 60 ){
//     print_line("HUMIDITY LOW", 2, 50, 1.75);
//     digitalWrite(LED_1, HIGH);
//   }
// }

